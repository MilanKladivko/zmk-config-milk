#include <behaviors.dtsi>
#include <dt-bindings/zmk/keys.h>
#include <dt-bindings/zmk/bt.h>

/ {
  keymap {
    compatible = "zmk,keymap";
    default_layer {
      label = "testing layer";
      bindings = <
  &kp A   &kp B   &kp C   &kp D   &kp E   &kp F   &kp G   &kp H   &kp I   &kp J   &kp K   &kp L   &kp M   &kp N   &kp O   &kp P
    // &kp Q
    // &kp R
    // &kp S
    // &kp T
    // &kp U
    // &kp V
    // &kp W
    // &kp X
    // &kp Y
    // &kp Z
      >;
    };
  };
};
