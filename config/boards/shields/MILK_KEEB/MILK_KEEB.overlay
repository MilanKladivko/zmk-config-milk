#include <dt-bindings/zmk/matrix_transform.h>

/ {
  chosen {
    zmk,kscan = &kscan__direct;
    // zmk,matrix_transform = &transform__direct;
  };

  //--- DIRECT_PIN:
  kscan__direct: kscan__direct {
    compatible = "zmk,kscan-gpio-direct";
    label = "kscan__direct";
    input-gpios 
      = <&gpio0  6 (GPIO_ACTIVE_LOW | GPIO_PULL_UP)>
      , <&gpio0  8 (GPIO_ACTIVE_LOW | GPIO_PULL_UP)>
      , <&gpio0 17 (GPIO_ACTIVE_LOW | GPIO_PULL_UP)>
      , <&gpio0 20 (GPIO_ACTIVE_LOW | GPIO_PULL_UP)>
      , <&gpio0 22 (GPIO_ACTIVE_LOW | GPIO_PULL_UP)>
      , <&gpio0 24 (GPIO_ACTIVE_LOW | GPIO_PULL_UP)>
      , <&gpio1  0 (GPIO_ACTIVE_LOW | GPIO_PULL_UP)>
      , <&gpio0 11 (GPIO_ACTIVE_LOW | GPIO_PULL_UP)>
      , <&gpio1  4 (GPIO_ACTIVE_LOW | GPIO_PULL_UP)>
      , <&gpio0 31 (GPIO_ACTIVE_LOW | GPIO_PULL_UP)>
      , <&gpio0 29 (GPIO_ACTIVE_LOW | GPIO_PULL_UP)>
      , <&gpio0  2 (GPIO_ACTIVE_LOW | GPIO_PULL_UP)>
      , <&gpio1 15 (GPIO_ACTIVE_LOW | GPIO_PULL_UP)>
      , <&gpio1 13 (GPIO_ACTIVE_LOW | GPIO_PULL_UP)>
      , <&gpio1 11 (GPIO_ACTIVE_LOW | GPIO_PULL_UP)>
      , <&gpio0 10 (GPIO_ACTIVE_LOW | GPIO_PULL_UP)>
      ;
  };
  //--- :DIRECT_PIN

  //--- MATRIX: 
  // kscan__matrix: kscan__matrix {
  //   compatible = "zmk,kscan-gpio-matrix";
  //   label = "kscan__matrix";
  //   diode_direction = "col2row";
  //   row-gpios
  //       = <&pro_micro 19 (GPIO_ACTIVE_HIGH | GPIO_PULL_DOWN)>
  //       , <&pro_micro 20 (GPIO_ACTIVE_HIGH | GPIO_PULL_DOWN)>
  //       , <&pro_micro 21 (GPIO_ACTIVE_HIGH | GPIO_PULL_DOWN)>
  //     ;
  //   col-gpios
  //     = <&pro_micro 4 (GPIO_ACTIVE_HIGH)>
  //     , <&pro_micro 5 (GPIO_ACTIVE_HIGH)>
  //     , <&pro_micro 5 (GPIO_ACTIVE_HIGH)>
  //     ;
  // };
  // transform__matrix: transform__matrix {
  //   compatible = "zmk,matrix-transform";
  //   rows = <3>;
  //   cols = <3>;
  //   map = <
  //     RC(0,0) RC(0,1) RC(0,2)
  //     RC(1,0) RC(1,1) RC(1,2)
  //     RC(2,0) RC(2,1) RC(2,2)
  //   >;
  // };
  //--- :MATRIX
};
